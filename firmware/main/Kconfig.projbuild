## firmware/main/Kconfig.projbuild
```kconfig
menu "SCARA micro-ROS app"

    config MICRO_ROS_APP_STACK
        int "Stack of the micro-ROS task (bytes)"
        default 16000

    config MICRO_ROS_APP_TASK_PRIO
        int "Priority of the micro-ROS task"
        default 5

endmenu
```
